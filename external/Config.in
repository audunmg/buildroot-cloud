## external/configs/oracle_x86_64_defconfig
```kconfig
# Architecture
BR2_x86_64=y
BR2_GCC_TARGET_ARCH="haswell"
BR2_x86_haswell=y

BR2_TARGET_ENABLE_ROOT_LOGIN=n
#BR2_TARGET_GENERIC_ROOT_PASSWD="pass"

# System
BR2_TARGET_GENERIC_GETTY_PORT="ttyS0"
BR2_SYSTEM_DHCP="eth0"

BR2_ROOTFS_POST_FAKEROOT_SCRIPT="$(BR2_EXTERNAL)/board/cloud/custom-fakeroot-script.sh"

BR2_ROOTFS_POST_BUILD_SCRIPT="$(BR2_EXTERNAL)/board/cloud/post-build.sh"
BR2_ROOTFS_POST_IMAGE_SCRIPT="$(BR2_EXTERNAL)/board/cloud/post-image-efi.sh"

BR2_TARGET_ROOTFS_SQUASHFS=y
#BR2_TARGET_ROOTFS_SQUASHFS4_GZIP=y
#BR2_TARGET_ROOTFS_SQUASHFS4_ZSTD=y
BR2_TARGET_ROOTFS_SQUASHFS_EXTREME_COMP=y
BR2_TARGET_ROOTFS_SQUASHFS4_XZ=y





# Required tools to create bootable media
BR2_PACKAGE_HOST_GENIMAGE=y

# Bootloader
BR2_TARGET_GRUB2=y
BR2_TARGET_GRUB2_INSTALL_TOOLS=y
BR2_TARGET_GRUB2_HAS_EFI_BOOT=y
BR2_TARGET_GRUB2_HAS_PTF=y
BR2_TARGET_GRUB2_X86_64_EFI=y
BR2_TARGET_GRUB2_BUILTIN_MODULES_EFI="boot linux ext2 fat squash4 part_msdos part_gpt normal efi_gop"


#QOL
BR2_USE_WCHAR=y
BR2_ENABLE_LOCALE=y
BR2_ENABLE_LOCALE_WHITELIST="C en_US ja_JP"
BR2_TARGET_TZ_INFO=y
BR2_TARGET_TZ_ZONELIST="asia europe etcetera"
#BR2_TARGET_TZ_ZONELIST="africa antarctica asia australasia europe northamerica southamerica etcetera backward factory"
BR2_TARGET_LOCALTIME="Asia/Tokyo"

# system
BR2_ROOTFS_DEVICE_CREATION_DYNAMIC_DEVTMPFS=y


# Linux
BR2_LINUX_KERNEL=y
BR2_LINUX_KERNEL_VERSION="6.1.30"
BR2_KERNEL_HEADERS_6_1=y
BR2_LINUX_KERNEL_USE_CUSTOM_CONFIG=y
BR2_LINUX_KERNEL_CUSTOM_CONFIG_FILE="$(BR2_EXTERNAL)/configs/linux-oracle-config"
BR2_LINUX_KERNEL_ZSTD=y
BR2_LINUX_KERNEL_NEEDS_HOST_OPENSSL=y

# Busybox
BR2_PACKAGE_BUSYBOX_CONFIG_FRAGMENT_FILES="$(BR2_EXTERNAL)/configs/busybox-cloud.config"

BR2_PACKAGE_JQ=y
BR2_PACKAGE_BTRFS_PROGS=y
BR2_PACKAGE_EUDEV=y
BR2_PACKAGE_PROVIDES_UDEV="eudev"
BR2_PACKAGE_EUDEV_ENABLE_HWDB=y
BR2_PACKAGE_HAS_UDEV=y
BR2_PACKAGE_LZ4=y
BR2_PACKAGE_LZ4_PROGS=y

BR2_PACKAGE_CA_CERTIFICATES=y
BR2_PACKAGE_SQLITE=y
BR2_PACKAGE_WOLFSSL=y
BR2_PACKAGE_WOLFSSL_ALL=y

BR2_PACKAGE_LUA=y
BR2_PACKAGE_LUA_CJSON=y
BR2_PACKAGE_LUA_CURL=y
BR2_PACKAGE_LUA_UTF8=y
BR2_PACKAGE_LUAPOSIX=y
BR2_PACKAGE_LUASOCKET=y
BR2_PACKAGE_LSQLITE3=y



BR2_PACKAGE_LIBCURL=y
BR2_PACKAGE_LIBCURL_CURL=y
BR2_PACKAGE_LIBCURL_PROXY_SUPPORT=y
BR2_PACKAGE_LIBCURL_COOKIES_SUPPORT=y
BR2_PACKAGE_LIBCURL_EXTRA_PROTOCOLS_FEATURES=y
BR2_PACKAGE_LIBCURL_WOLFSSL=y

BR2_PACKAGE_TZDATA=y
BR2_PACKAGE_COLLECTD=y
BR2_PACKAGE_COLLECTD_REGEX=y
BR2_PACKAGE_COLLECTD_LOGFILE=y
BR2_PACKAGE_COLLECTD_SYSLOG=y
BR2_PACKAGE_COLLECTD_CPU=y
BR2_PACKAGE_COLLECTD_DF=y
BR2_PACKAGE_COLLECTD_DISK=y
BR2_PACKAGE_COLLECTD_MEMORY=y
BR2_PACKAGE_COLLECTD_MQTT=y
BR2_PACKAGE_MOSQUITTO_BROKER=n
BR2_PACKAGE_COLLECTD_LUA=y
BR2_PACKAGE_COLLECTD_CONTEXTSWITCH=y
# BR2_PACKAGE_COLLECTD_NETWORK=y

# External cloudrc package
BR2_PACKAGE_CLOUD_RC=y=

BR2_PACKAGE_DNSMASQ=y
BR2_PACKAGE_DNSMASQ_DHCP=y

BR2_PACKAGE_DROPBEAR=y
BR2_PACKAGE_DROPBEAR_CLIENT=y
BR2_PACKAGE_DROPBEAR_SMALL=y

BR2_PACKAGE_IPTABLES=y
BR2_PACKAGE_TCPDUMP=y
BR2_PACKAGE_WIREGUARD_TOOLS=y

BR2_PACKAGE_BALENA_ENGINE=y

BR2_PACKAGE_CONTAINERD=y
BR2_PACKAGE_CONTAINERD_DRIVER_BTRFS=y

BR2_PACKAGE_DOCKER_CLI=y

BR2_PACKAGE_DOCKER_COMPOSE=y
BR2_PACKAGE_DOCKER_ENGINE=y
BR2_PACKAGE_DOCKER_ENGINE_DRIVER_BTRFS=y
BR2_PACKAGE_DOCKER_ENGINE_DRIVER_DEVICEMAPPER=y


BR2_PACKAGE_EFIBOOTMGR=y
BR2_PACKAGE_EFIVAR=y
BR2_PACKAGE_EMBIGGEN_DISK=y

BR2_PACKAGE_HTOP=y
BR2_PACKAGE_PV=y



# For the shutdown
BR2_PACKAGE_ACPID=y
```

## external/package/Config.in
```kconfig
menu "Cloud-external packages"
	source "$BR2_EXTERNAL_CLOUDIMAGE_PATH/package/cloud-rc/Config.in"
endmenu
```

## external/package/cloud-rc/Config.in
```kconfig
config BR2_PACKAGE_CLOUD_RC
        bool "cloud-rc"
        depends on BR2_PACKAGE_JQ
        help
          Initscripts to configure a vm on cloud-providers
          Currently only aws, openstack and oracle.
```
